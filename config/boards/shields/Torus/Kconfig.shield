## config/boards/shields/Torus/Kconfig.shield
```kconfig
config SHIELD_TORUS_LEFT
    def_bool $(shields_list_contains,Torus_left)

config SHIELD_TORUS_RIGHT
    def_bool $(shields_list_contains,Torus_right)
```
