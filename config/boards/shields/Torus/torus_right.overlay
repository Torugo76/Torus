#include "torus.dtsi"

//Deslocamento (col-offset) de 6 porque o lado esquerdo tem 6 colunas, entao para lado direito, tem que pular essas colunas.
&default_transform {
    col-offset = <6>;
};



// Essas linhas nao precisam estar igualmentente soldadas em cada lado mas de preferência soldar iguais. Mas provavel que tenha que inverter no outro '.overlay' a ordem se estiver ao contrario.
&kscan0 {
    col-gpios
        = <&pro_micro 9 GPIO_ACTIVE_HIGH>
        , <&pro_micro 8 GPIO_ACTIVE_HIGH>
        , <&pro_micro 7 GPIO_ACTIVE_HIGH>
        , <&pro_micro 6 GPIO_ACTIVE_HIGH>
        , <&pro_micro 5 GPIO_ACTIVE_HIGH>
        , <&pro_micro 4 GPIO_ACTIVE_HIGH>
        ;
};
